## sdkconfig.defaults
```kconfig
#
# Display Pin Assignments
#
CONFIG_LV_DISP_SPI_MOSI=7
CONFIG_LV_DISPLAY_USE_SPI_MISO=y
CONFIG_LV_DISP_SPI_MISO=2
CONFIG_LV_DISP_SPI_INPUT_DELAY_NS=0
CONFIG_LV_DISP_SPI_CLK=6
CONFIG_LV_DISPLAY_USE_SPI_CS=y
CONFIG_LV_DISP_SPI_CS=10
CONFIG_LV_DISPLAY_USE_DC=y
CONFIG_LV_DISP_PIN_DC=4
CONFIG_LV_DISP_PIN_RST=3
CONFIG_LV_DISP_PIN_BUSY=35
# CONFIG_LV_ENABLE_BACKLIGHT_CONTROL is not set
CONFIG_LV_DISP_PIN_SDA=5
CONFIG_LV_DISP_PIN_SCL=4
# end of Display Pin Assignments
# end of LVGL TFT Display controller
```
